## scanner/firmware/esp32-bridge/main/Kconfig.projbuild
```kconfig
menu "ScanIt scanner bridge"

config SCANIT_WIFI_SSID
    string "Scanner access-point SSID"
    default "ScanIt-Scanner"

config SCANIT_WIFI_PASSWORD
    string "Scanner access-point password"
    default "scanit-lab"

config SCANIT_UART_RX_PIN
    int "SCN1 UART RX pin"
    default 18

config SCANIT_UART_TX_PIN
    int "SCN1 UART TX pin"
    default 17

config SCANIT_UART_BAUD
    int "SCN1 UART baud rate"
    default 2000000

endmenu
```

## scanner/firmware/esp32-bridge/sdkconfig.defaults
```kconfig
CONFIG_BT_ENABLED=y
CONFIG_BT_NIMBLE_ENABLED=y
CONFIG_BT_CONTROLLER_ENABLED=y
CONFIG_ESP_HTTP_SERVER_ENABLE=y
CONFIG_ESP_WIFI_ENABLED=y
CONFIG_ESP_MAIN_TASK_STACK_SIZE=8192
```

## scanner/firmware/esp32-wifi-csi/main/Kconfig.projbuild
```kconfig
menu "ScanIt Wi-Fi CSI receiver"

config SCANIT_CSI_CHANNEL
    int "Controlled sounding channel"
    range 36 177
    default 36

config SCANIT_CSI_MATCH_WINDOW_US
    int "Maximum SND1-to-CSI timestamp delta (microseconds)"
    range 50 5000
    default 750

config SCANIT_CSI_UART_PORT
    int "Dedicated binary CSI0 UART port"
    range 1 2
    default 1

config SCANIT_CSI_UART_TX_GPIO
    int "CSI0 UART TX GPIO"
    default 5

config SCANIT_CSI_UART_RX_GPIO
    int "CSI0 UART RX GPIO"
    default 4

config SCANIT_CSI_UART_BAUD
    int "CSI0 UART baud rate"
    range 115200 5000000
    default 2000000

endmenu
```

## scanner/firmware/esp32-wifi-csi/sdkconfig.defaults
```kconfig
CONFIG_ESP_WIFI_CSI_ENABLED=y
CONFIG_ESP_WIFI_ENABLE_WPA3_SAE=y
CONFIG_FREERTOS_HZ=1000
CONFIG_ESP_MAIN_TASK_STACK_SIZE=6144
CONFIG_LOG_DEFAULT_LEVEL_INFO=y
CONFIG_ESPTOOLPY_FLASHSIZE_4MB=y
```

## scanner/firmware/esp32-wifi-sounding/main/Kconfig.projbuild
```kconfig
menu "ScanIt controlled Wi-Fi sounding"

config SCANIT_SOUNDING_CHANNEL
    int "5 GHz Wi-Fi channel"
    range 36 177
    default 36

config SCANIT_SOUNDING_RATE_HZ
    int "Sounding rate (Hz)"
    range 1 100
    default 20

config SCANIT_SOUNDING_SESSION_NONCE
    hex "Session nonce"
    default 0x5343414E
    help
        Static development nonce. Production runs should supply a fresh session
        nonce from the gateway before capture.

endmenu
```

## scanner/firmware/esp32-wifi-sounding/sdkconfig.defaults
```kconfig
CONFIG_FREERTOS_HZ=1000
CONFIG_ESP_WIFI_ENABLE_WPA3_SAE=y
CONFIG_LOG_DEFAULT_LEVEL_INFO=y
```
